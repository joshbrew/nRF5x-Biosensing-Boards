## CMakeLists.txt
```
cmake_minimum_required(VERSION 3.20.0)

# set(DTC_OVERLAY_FILE "nrf5340dk_nrf5340.overlay")
set(DTS_ROOT "${CMAKE_CURRENT_SOURCE_DIR}/dts")

# Get the parent directory of ZEPHYR_BASE
# get_filename_component(PARENT_DIR ${ZEPHYR_BASE} DIRECTORY)
# set(MODULE_DIR "${PARENT_DIR}/modules")


find_package(Zephyr REQUIRED HINTS $ENV{ZEPHYR_BASE})


FILE(GLOB app_sources src/*.c*)
target_sources(app PRIVATE ${app_sources})

target_include_directories(app PRIVATE
                            include
                            include/Transports)

set_property(TARGET app PROPERTY CXX_STANDARD 17)

project(BT40_port_to_3.5)
```

## Kconfig
```
# SPDX-License-Identifier: Proprietary

mainmenu "Application"

    config NUM_TLCS
        int "Number of chained TLC drivers"
        default 1
        range 1 8

    config UART_RX_TX_BUF_SZ
        int "The size of RP2040 UART RX buffer"
        default 32
        range 1 256

    config UART_RX_TOUT_US
        int "UART RX timeout in milliseconds"
        default 100000

    config USE_ADS131M08
        bool "Include the ADS131M08 sensors in compilation"
        default n

    config USE_ADS131M08_1
        bool "Include the ADS131M08_1 sensors in compilation"
        default n

    config USE_BME280
        bool "Include the BME280 sensor in compilation"
        default n
        select USE_USB
        select SENSOR
        select BME280      

    config USE_MAX30102
        bool "Include the MAX30102 sensor in compilation"
        default n
        select USE_USB

    config USE_MPU6050
        bool "Include the MPU6050 sensor in compilation"
        default n
        select USE_USB 

    config USE_QMC5883L
        bool "Include the QMC5883L sensor in compilation"
        default n  
        select USE_USB

    config USE_TLC5940
        bool "Include the TLC5940 sensor in compilation"
        default n

    config USE_DMIC
        bool "Include the Digital Microphone in compilation"
        default n  

    config USE_I2S
        bool "Include the I2S driver for controlling MAX98357A Class D audio amplifier"
        default n          

    config USE_USB
        bool "Include the USB driver for sending sensor samples over USB"
        default n 

    config USE_MCU2MCU
        bool "Include the UART driver for communication with RP2040"
        default n    

source "Kconfig.zephyr"
```

## prj.conf
```kconfig
CONFIG_INIT_STACKS=y
CONFIG_THREAD_STACK_INFO=y
CONFIG_MAIN_STACK_SIZE=2048
CONFIG_SYSTEM_WORKQUEUE_STACK_SIZE=4096
CONFIG_BT_RX_STACK_SIZE=4096

# PWM
#CONFIG_PWM=y
#CONFIG_PWM_NRF5_SW=n
#CONFIG_PWM_NRFX=y

# Communication protocols
CONFIG_GPIO=y
CONFIG_I2C=y
CONFIG_SPI=y
#CONFIG_SPI_0=y

# choose UART console
CONFIG_UART_CONSOLE=n
CONFIG_LOG_BACKEND_UART=n

# Debug config
CONFIG_LOG=y
CONFIG_LOG_DEFAULT_LEVEL=3
CONFIG_LOG_MAX_LEVEL=3
# RTT Viewer
CONFIG_USE_SEGGER_RTT=y
CONFIG_LOG_BACKEND_RTT=y
CONFIG_RTT_CONSOLE=y
CONFIG_SEGGER_RTT_BUFFER_SIZE_UP=4096
#CONFIG_LOG_BACKEND_RTT_MODE_DROP=y
CONFIG_LOG_PRINTK=y

# BLE
CONFIG_BT=y
#CONFIG_BT_DEBUG_LOG=y
CONFIG_BT_PERIPHERAL=y
CONFIG_BT_CENTRAL=y
CONFIG_BT_DEVICE_NAME="BT40"
CONFIG_BT_GATT_CLIENT=y
CONFIG_BT_HCI_ACL_FLOW_CONTROL=y

#CONFIG_BT_CTLR=y
#CONFIG_BT_CTLR_PHY=y
#CONFIG_BT_CTLR_ADV_EXT=y
#CONFIG_BT_CTLR_PHY_2M_SUPPORT=y

#CONFIG_ENTROPY_GENERATOR=y
#CONFIG_ENTROPY_NRF5_RNG=y

CONFIG_BT_USER_PHY_UPDATE=y
CONFIG_BT_CTLR_PHY_2M=y
CONFIG_BT_CTLR_PHY_CODED=n
CONFIG_BT_ATT_PREPARE_COUNT=10
CONFIG_BT_CONN_TX_MAX=10
CONFIG_BT_L2CAP_TX_BUF_COUNT=10
CONFIG_BT_BUF_ACL_TX_SIZE=250

# Allow for large Bluetooth data packets.
CONFIG_BT_L2CAP_TX_MTU=252
CONFIG_BT_BUF_ACL_RX_SIZE=256


# Enable the Bluetooth (unauthenticated) and shell mcumgr transports.
# CONFIG_MCUMGR_SMP_BT=y
# CONFIG_MCUMGR_SMP_BT_AUTHEN=n
# CONFIG_MCUMGR_SMP_BT_CONN_PARAM_CONTROL=y
########################################################

# C++
#CONFIG_STATIC_INIT_GNU=y
CONFIG_CPP=y
CONFIG_STD_CPP17=y
CONFIG_NEWLIB_LIBC=y

#if  printf should be able to print float
CONFIG_NEWLIB_LIBC_FLOAT_PRINTF=y

#ADS131M08
CONFIG_USE_ADS131M08=y

#MAX30102
CONFIG_USE_MAX30102=y

#MPU6050
CONFIG_USE_MPU6050=y

#QMC
CONFIG_USE_QMC5883L=y

#TLC5940 LED Driver
# CONFIG_USE_TLC5940=y

#BME280
CONFIG_USE_BME280=y

#I2S AudioModule
#CONFIG_I2S=y
#CONFIG_USE_I2S=y

# Digital Microphone (DMIC) Module
#CONFIG_AUDIO=y
#CONFIG_USE_DMIC=y

# For FFT implementation
CONFIG_CMSIS_DSP=y
CONFIG_CMSIS_DSP_TRANSFORM=y
CONFIG_CMSIS_DSP_COMPLEXMATH=y
CONFIG_NEWLIB_LIBC=y
CONFIG_FPU=y

#USB transfer
#CONFIG_USB=y
CONFIG_USB_DEVICE_STACK=y #set to y if using usb
CONFIG_USB_DEVICE_PRODUCT="BT40"
CONFIG_USB_DEVICE_MANUFACTURER="joshuaBrewster"
CONFIG_USB_DRIVER_LOG_LEVEL_DBG=y
# Enable the USB CDC ACM driver (optional, for serial communication over USB)
CONFIG_USB_CDC_ACM=y
CONFIG_USB_CDC_ACM_LOG_LEVEL_INF=y
CONFIG_UART_LINE_CTRL=y
CONFIG_UART_ASYNC_API=y
CONFIG_UART_INTERRUPT_DRIVEN=y



CONFIG_HEAP_MEM_POOL_SIZE=4096

#Enable/Include Sensors. The sensor should be included with setting
# CONFIG_USE_SENSOR_NAME flag to y. For example: CONFIG_USE_BME280=y
# See Kconfig file for the full list of supported sensors
CONFIG_USE_MCU2MCU=y

# Needed for FOTA
########################################################
# Enable mcumgr.
# Ensure an MCUboot-compatible binary is generated.
CONFIG_BOOTLOADER_MCUBOOT=y


CONFIG_ZCBOR=y
CONFIG_MCUMGR=y
CONFIG_MCUMGR_TRANSPORT_BT=y

#CONFIG_NCS_BOOT_BANNER=n
#CONFIG_BOOT_BANNER=y
#CONFIG_BOOT_BANNER_STRING="Booting BT40 + ADS131M08"
CONFIG_NCS_SAMPLE_MCUMGR_BT_OTA_DFU=y
```

## dts/bindings/joshua,max30102-i2c.yaml
```yaml
description: MAX30102 heart rate sensor

compatible: "joshua,max30102"

include: [sensor-device.yaml, i2c-device.yaml]

on-bus: i2c
```

## include/max30102.hpp
```c
#pragma once

#include <zephyr/types.h>
#include <zephyr/device.h>
#include <zephyr/drivers/gpio.h>
//#include <drivers/i2c.h>
#include <zephyr/sys/util.h>
#include <zephyr/sys/atomic.h>
#include "i2c_transport.hpp"
#include "device_string.hpp"
#include "ble_types.hpp"
#include "ble_commands.hpp"

class UsbCommHandler;
//#define DT_DRV_COMPAT maxim_max30102

#define MAX30102_REG_INT_STS1 0x00
#define MAX30102_REG_INT_STS2 0x01
#define MAX30102_REG_INT_EN1 0x02
#define MAX30102_REG_INT_EN2 0x03
#define MAX30102_REG_FIFO_WR 0x04
#define MAX30102_REG_FIFO_OVF 0x05
#define MAX30102_REG_FIFO_RD 0x06
#define MAX30102_REG_FIFO_DATA 0x07
#define MAX30102_REG_FIFO_CFG 0x08
#define MAX30102_REG_MODE_CFG 0x09
#define MAX30102_REG_SPO2_CFG 0x0a
#define MAX30102_REG_LED1_PA 0x0c
#define MAX30102_REG_LED2_PA 0x0d
/* #define MAX30102_REG_LED3_PA		0x0e */
#define MAX30102_REG_PILOT_PA 0x10
#define MAX30102_REG_MULTI_LED1 0x11
#define MAX30102_REG_MULTI_LED2 0x12
#define MAX30102_REG_TINT 0x1f
#define MAX30102_REG_TFRAC 0x20
#define MAX30102_REG_TEMP_CFG 0x21
#define MAX30102_REG_PROX_INT 0x30
#define MAX30102_REG_REV_ID 0xfe
#define MAX30102_REG_PART_ID 0xff

#define MAX30102_INT_PPG_MASK (1 << 6)

#define MAX30102_FIFO_CFG_SMP_AVE_SHIFT 5
#define MAX30102_FIFO_CFG_FIFO_FULL_SHIFT 0
#define MAX30102_FIFO_CFG_ROLLOVER_EN_MASK (1 << 4)

#define MAX30102_MODE_CFG_SHDN_MASK (1 << 7)
#define MAX30102_MODE_CFG_RESET_MASK (1 << 6)

#define MAX30102_SPO2_ADC_RGE_SHIFT 5
#define MAX30102_SPO2_SR_SHIFT 2
#define MAX30102_SPO2_PW_SHIFT 0

#define MAX30102_PART_ID 0x15

#define FIFO_A_FULL_MASK    (1 << 7)
#define PPG_RDY_MASK        (1 << 6)
#define ALC_OVF_MASK        (1 << 5)
#define PWR_RDY_MASK        (1 << 0)
#define DIE_TEMP_RDY_MASK   (1 << 1)

#define MAX30102_BYTES_PER_CHANNEL 3
#define MAX30102_MAX_NUM_CHANNELS 2
#define MAX30102_MAX_BYTES_PER_SAMPLE (MAX30102_MAX_NUM_CHANNELS * \
                                       MAX30102_BYTES_PER_CHANNEL)

#define MAX30102_SLOT_LED_MASK 0x03

#define MAX30102_FIFO_DATA_BITS 18
#define MAX30102_FIFO_DATA_MASK ((1 << MAX30102_FIFO_DATA_BITS) - 1)

#define MAX30102_INTR_2_DIE_TEMP_RDY_EN 2
#define MAX30102_TEMP_CFG_TEMP_EN 1

/* Interrupt Status 1 Register */
#define MAX30102_INTR_STATUS_1_A_FULL(x) (((x) >> 7) & 0x1)
#define MAX30102_INTR_STATUS_1_PPG_RDY(x) (((x) >> 6) & 0x1)
#define MAX30102_INTR_STATUS_1_ALC_OVF(x) (((x) >> 5) & 0x1)
#define MAX30102_INTR_STATUS_1_PWR_RDY(x) (((x) >> 0) & 0x1)

/* Interrupt Status 2 Register */
#define MAX30102_INTR_STATUS_2_DIE_TEMP_RDY(x) (((x) >> 1) & 0x1)

    struct max30102_config {
        uint8_t interrupt_config_1;
        uint8_t interrupt_config_2;
        uint8_t fifo_config;
        uint8_t mode_config;
        uint8_t spo2_config;
        uint8_t led_pa[MAX30102_MAX_NUM_CHANNELS];
        uint8_t slot_config[MAX30102_MAX_NUM_CHANNELS];
    };

    enum class max30102_mode : uint8_t {
        MAX30102_MODE_HEART_RATE = 2,
        MAX30102_MODE_SPO2 = 3,
        MAX30102_MODE_MULTI_LED = 7,
    };

    enum class max30102_slot : uint8_t {
        MAX30102_SLOT_DISABLED = 0,
        MAX30102_SLOT_RED_LED1_PA,
        MAX30102_SLOT_IR_LED2_PA,
        MAX30102_SLOT_GREEN_LED3_PA,
        MAX30102_SLOT_RED_PILOT_PA,
        MAX30102_SLOT_IR_PILOT_PA,
        MAX30102_SLOT_GREEN_PILOT_PA,
    };

    enum class max30102_led_channel : uint8_t {
        MAX30102_LED_CHANNEL_RED = 0,
        MAX30102_LED_CHANNEL_IR,
        MAX30102_LED_CHANNEL_GREEN,
    };

    enum class max30102_pw : uint8_t {
        MAX30102_PW_15BITS = 0,
        MAX30102_PW_16BITS,
        MAX30102_PW_17BITS,
        MAX30102_PW_18BITS,
    };

    enum class max30102_intr_1 : uint8_t {
        MAX30102_INTR_1_ALC_OVF_EN = 32,
        MAX30102_INTR_1_PPG_RDY_EN = 64,
        MAX30102_INTR_1_A_FULL_EN = 128,
    };

/**
 * @brief Max30102 driver
 */
class Max30102 {

    // using I2C_1DeviceName = DeviceString<'I', '2', 'C', '_', '1'>;
    // using I2C_1DeviceName = DeviceString<'i', '2', 'c', '1', 'm', 'a', 'x'>;
    using I2C_1DeviceName = DeviceString<'m', 'a', 'x', '3', '0', '1', '0', '2'>;


    constexpr static uint8_t max30102_i2c_address = 0x57; //I2C Address
    constexpr static uint8_t max30102_id = 0x15; // Part ID
    uint8_t tx_buf[195] = {};

    struct max30102_data {
        const struct device *i2c;
        uint32_t raw[MAX30102_MAX_NUM_CHANNELS];
        uint8_t map[MAX30102_MAX_NUM_CHANNELS];
        uint8_t num_channels;

        /* Die temperature */
        int8_t tint;
        uint8_t tfrac;
    };

public:
    /**
     * @brief Construct a new Max30102 object
     */
    Max30102(UsbCommHandler &controller);

    /**
     * @brief Initialization function. Used to perform actual initialization. Because of software stack initialization
     * could not be done in constructor
     * @return Status, 0 for no errors
     */
    int Initialize();    

    /**
     * @brief Configure Max30102 device
     * 
     * @param config Configuration details
     * @return Status, 0 for no errors
     */
    int Configure(max30102_config config);

    /**
     * @brief Start taking Red and IR samples
     */
    void StartSampling();    

    /**
     * @brief Stop taking Red and IR samples
     */
    void StopSampling();

    /**
     * @brief Initiate Single Temperature Reading. Max30102 will generate interrupt when temperature sample is available.
     */
    void InitiateTemperatureReading();    

    /**
     * @brief Handle Max30102 Interrupt. Figure out interrupt reason and take the appropriate action
     */
    void HandleInterrupt(); 

    /**
     * @brief Check if MAX30102 device is connected to I2C bus
     */
    bool IsOnI2cBus(); 

private:
    /**
     * @brief Reset Max30102 device
     */
    void Reset();

    /**
     * @brief Shutdown Max30102 device
     */
    void Shutdown();

    /**
     * @brief Wakeup Max30102 device
     */
    void Wakeup();

    /**
     * @brief Called when trigger mode is received via BLE
     * 
     * @param buffer receviced buffer
     * @param length buffer length
     * @param offset data offset
     * 
     * @return true if command was processed succesfully
     */
    bool OnBleCommand(const uint8_t* buffer, Bluetooth::CommandKey key, Bluetooth::BleLength length, Bluetooth::BleOffset offset);

    /**
     * @brief Read Temperature Registers
     */
    void TemperatureRead();
    uint8_t packet_cnt;
    std::atomic<bool> max30102_is_on_i2c_bus_; ///< Device status
    I2CTransport<I2C_1DeviceName, max30102_i2c_address> transport; ///< I2C transport for device
    UsbCommHandler &serialHandler; ///< USB communication controller
};
```

## include/mpu6050.hpp
```c
#pragma once

#include <zephyr/types.h>
#include <zephyr/device.h>
#include <zephyr/drivers/gpio.h>
//#include <drivers/i2c.h>
#include <zephyr/sys/util.h>
#include <zephyr/sys/atomic.h>
#include "i2c_transport.hpp"
#include "device_string.hpp"
#include "ble_types.hpp"
#include "ble_commands.hpp"

class UsbCommHandler;

#define MPU6050_ADDRESS_AD0_LOW     0x68 // address pin low (GND), default for InvenSense evaluation board
#define MPU6050_ADDRESS_AD0_HIGH    0x69 // address pin high (VCC)
#define MPU6050_DEFAULT_ADDRESS     MPU6050_ADDRESS_AD0_LOW

#define MPU6050_RA_XG_OFFS_TC       0x00 //[7] PWR_MODE, [6:1] XG_OFFS_TC, [0] OTP_BNK_VLD
#define MPU6050_RA_YG_OFFS_TC       0x01 //[7] PWR_MODE, [6:1] YG_OFFS_TC, [0] OTP_BNK_VLD
#define MPU6050_RA_ZG_OFFS_TC       0x02 //[7] PWR_MODE, [6:1] ZG_OFFS_TC, [0] OTP_BNK_VLD
#define MPU6050_RA_X_FINE_GAIN      0x03 //[7:0] X_FINE_GAIN
#define MPU6050_RA_Y_FINE_GAIN      0x04 //[7:0] Y_FINE_GAIN
#define MPU6050_RA_Z_FINE_GAIN      0x05 //[7:0] Z_FINE_GAIN
#define MPU6050_RA_XA_OFFS_H        0x06 //[15:0] XA_OFFS
#define MPU6050_RA_XA_OFFS_L_TC     0x07
#define MPU6050_RA_YA_OFFS_H        0x08 //[15:0] YA_OFFS
#define MPU6050_RA_YA_OFFS_L_TC     0x09
#define MPU6050_RA_ZA_OFFS_H        0x0A //[15:0] ZA_OFFS
#define MPU6050_RA_ZA_OFFS_L_TC     0x0B
#define MPU6050_RA_SELF_TEST_X      0x0D //[7:5] XA_TEST[4-2], [4:0] XG_TEST[4-0]
#define MPU6050_RA_SELF_TEST_Y      0x0E //[7:5] YA_TEST[4-2], [4:0] YG_TEST[4-0]
#define MPU6050_RA_SELF_TEST_Z      0x0F //[7:5] ZA_TEST[4-2], [4:0] ZG_TEST[4-0]
#define MPU6050_RA_SELF_TEST_A      0x10 //[5:4] XA_TEST[1-0], [3:2] YA_TEST[1-0], [1:0] ZA_TEST[1-0]
#define MPU6050_RA_XG_OFFS_USRH     0x13 //[15:0] XG_OFFS_USR
#define MPU6050_RA_XG_OFFS_USRL     0x14
#define MPU6050_RA_YG_OFFS_USRH     0x15 //[15:0] YG_OFFS_USR
#define MPU6050_RA_YG_OFFS_USRL     0x16
#define MPU6050_RA_ZG_OFFS_USRH     0x17 //[15:0] ZG_OFFS_USR
#define MPU6050_RA_ZG_OFFS_USRL     0x18
#define MPU6050_RA_SMPLRT_DIV       0x19
#define MPU6050_RA_CONFIG           0x1A
#define MPU6050_RA_GYRO_CONFIG      0x1B
#define MPU6050_RA_ACCEL_CONFIG     0x1C
#define MPU6050_RA_FF_THR           0x1D
#define MPU6050_RA_FF_DUR           0x1E
#define MPU6050_RA_MOT_THR          0x1F
#define MPU6050_RA_MOT_DUR          0x20
#define MPU6050_RA_ZRMOT_THR        0x21
#define MPU6050_RA_ZRMOT_DUR        0x22
#define MPU6050_RA_FIFO_EN          0x23
#define MPU6050_RA_I2C_MST_CTRL     0x24
#define MPU6050_RA_I2C_SLV0_ADDR    0x25
#define MPU6050_RA_I2C_SLV0_REG     0x26
#define MPU6050_RA_I2C_SLV0_CTRL    0x27
#define MPU6050_RA_I2C_SLV1_ADDR    0x28
#define MPU6050_RA_I2C_SLV1_REG     0x29
#define MPU6050_RA_I2C_SLV1_CTRL    0x2A
#define MPU6050_RA_I2C_SLV2_ADDR    0x2B
#define MPU6050_RA_I2C_SLV2_REG     0x2C
#define MPU6050_RA_I2C_SLV2_CTRL    0x2D
#define MPU6050_RA_I2C_SLV3_ADDR    0x2E
#define MPU6050_RA_I2C_SLV3_REG     0x2F
#define MPU6050_RA_I2C_SLV3_CTRL    0x30
#define MPU6050_RA_I2C_SLV4_ADDR    0x31
#define MPU6050_RA_I2C_SLV4_REG     0x32
#define MPU6050_RA_I2C_SLV4_DO      0x33
#define MPU6050_RA_I2C_SLV4_CTRL    0x34
#define MPU6050_RA_I2C_SLV4_DI      0x35
#define MPU6050_RA_I2C_MST_STATUS   0x36
#define MPU6050_RA_INT_PIN_CFG      0x37
#define MPU6050_RA_INT_ENABLE       0x38
#define MPU6050_RA_DMP_INT_STATUS   0x39
#define MPU6050_RA_INT_STATUS       0x3A
#define MPU6050_RA_ACCEL_XOUT_H     0x3B
#define MPU6050_RA_ACCEL_XOUT_L     0x3C
#define MPU6050_RA_ACCEL_YOUT_H     0x3D
#define MPU6050_RA_ACCEL_YOUT_L     0x3E
#define MPU6050_RA_ACCEL_ZOUT_H     0x3F
#define MPU6050_RA_ACCEL_ZOUT_L     0x40
#define MPU6050_RA_TEMP_OUT_H       0x41
#define MPU6050_RA_TEMP_OUT_L       0x42
#define MPU6050_RA_GYRO_XOUT_H      0x43
#define MPU6050_RA_GYRO_XOUT_L      0x44
#define MPU6050_RA_GYRO_YOUT_H      0x45
#define MPU6050_RA_GYRO_YOUT_L      0x46
#define MPU6050_RA_GYRO_ZOUT_H      0x47
#define MPU6050_RA_GYRO_ZOUT_L      0x48
#define MPU6050_RA_EXT_SENS_DATA_00 0x49
#define MPU6050_RA_EXT_SENS_DATA_01 0x4A
#define MPU6050_RA_EXT_SENS_DATA_02 0x4B
#define MPU6050_RA_EXT_SENS_DATA_03 0x4C
#define MPU6050_RA_EXT_SENS_DATA_04 0x4D
#define MPU6050_RA_EXT_SENS_DATA_05 0x4E
#define MPU6050_RA_EXT_SENS_DATA_06 0x4F
#define MPU6050_RA_EXT_SENS_DATA_07 0x50
#define MPU6050_RA_EXT_SENS_DATA_08 0x51
#define MPU6050_RA_EXT_SENS_DATA_09 0x52
#define MPU6050_RA_EXT_SENS_DATA_10 0x53
#define MPU6050_RA_EXT_SENS_DATA_11 0x54
#define MPU6050_RA_EXT_SENS_DATA_12 0x55
#define MPU6050_RA_EXT_SENS_DATA_13 0x56
#define MPU6050_RA_EXT_SENS_DATA_14 0x57
#define MPU6050_RA_EXT_SENS_DATA_15 0x58
#define MPU6050_RA_EXT_SENS_DATA_16 0x59
#define MPU6050_RA_EXT_SENS_DATA_17 0x5A
#define MPU6050_RA_EXT_SENS_DATA_18 0x5B
#define MPU6050_RA_EXT_SENS_DATA_19 0x5C
#define MPU6050_RA_EXT_SENS_DATA_20 0x5D
#define MPU6050_RA_EXT_SENS_DATA_21 0x5E
#define MPU6050_RA_EXT_SENS_DATA_22 0x5F
#define MPU6050_RA_EXT_SENS_DATA_23 0x60
#define MPU6050_RA_MOT_DETECT_STATUS    0x61
#define MPU6050_RA_I2C_SLV0_DO      0x63
#define MPU6050_RA_I2C_SLV1_DO      0x64
#define MPU6050_RA_I2C_SLV2_DO      0x65
#define MPU6050_RA_I2C_SLV3_DO      0x66
#define MPU6050_RA_I2C_MST_DELAY_CTRL   0x67
#define MPU6050_RA_SIGNAL_PATH_RESET    0x68
#define MPU6050_RA_MOT_DETECT_CTRL      0x69
#define MPU6050_RA_USER_CTRL        0x6A
#define MPU6050_RA_PWR_MGMT_1       0x6B
#define MPU6050_RA_PWR_MGMT_2       0x6C
#define MPU6050_RA_BANK_SEL         0x6D
#define MPU6050_RA_MEM_START_ADDR   0x6E
#define MPU6050_RA_MEM_R_W          0x6F
#define MPU6050_RA_DMP_CFG_1        0x70
#define MPU6050_RA_DMP_CFG_2        0x71
#define MPU6050_RA_FIFO_COUNTH      0x72
#define MPU6050_RA_FIFO_COUNTL      0x73
#define MPU6050_RA_FIFO_R_W         0x74
#define MPU6050_RA_WHO_AM_I         0x75

#define MPU6050_SELF_TEST_XA_1_BIT     0x07
#define MPU6050_SELF_TEST_XA_1_LENGTH  0x03
#define MPU6050_SELF_TEST_XA_2_BIT     0x05
#define MPU6050_SELF_TEST_XA_2_LENGTH  0x02
#define MPU6050_SELF_TEST_YA_1_BIT     0x07
#define MPU6050_SELF_TEST_YA_1_LENGTH  0x03
#define MPU6050_SELF_TEST_YA_2_BIT     0x03
#define MPU6050_SELF_TEST_YA_2_LENGTH  0x02
#define MPU6050_SELF_TEST_ZA_1_BIT     0x07
#define MPU6050_SELF_TEST_ZA_1_LENGTH  0x03
#define MPU6050_SELF_TEST_ZA_2_BIT     0x01
#define MPU6050_SELF_TEST_ZA_2_LENGTH  0x02

#define MPU6050_SELF_TEST_XG_1_BIT     0x04
#define MPU6050_SELF_TEST_XG_1_LENGTH  0x05
#define MPU6050_SELF_TEST_YG_1_BIT     0x04
#define MPU6050_SELF_TEST_YG_1_LENGTH  0x05
#define MPU6050_SELF_TEST_ZG_1_BIT     0x04
#define MPU6050_SELF_TEST_ZG_1_LENGTH  0x05

#define MPU6050_TC_PWR_MODE_BIT     7
#define MPU6050_TC_OFFSET_BIT       6
#define MPU6050_TC_OFFSET_LENGTH    6
#define MPU6050_TC_OTP_BNK_VLD_BIT  0

#define MPU6050_VDDIO_LEVEL_VLOGIC  0
#define MPU6050_VDDIO_LEVEL_VDD     1

#define MPU6050_CFG_EXT_SYNC_SET_BIT    5
#define MPU6050_CFG_EXT_SYNC_SET_LENGTH 3
#define MPU6050_CFG_DLPF_CFG_BIT    2
#define MPU6050_CFG_DLPF_CFG_LENGTH 3

#define MPU6050_EXT_SYNC_DISABLED       0x0
#define MPU6050_EXT_SYNC_TEMP_OUT_L     0x1
#define MPU6050_EXT_SYNC_GYRO_XOUT_L    0x2
#define MPU6050_EXT_SYNC_GYRO_YOUT_L    0x3
#define MPU6050_EXT_SYNC_GYRO_ZOUT_L    0x4
#define MPU6050_EXT_SYNC_ACCEL_XOUT_L   0x5
#define MPU6050_EXT_SYNC_ACCEL_YOUT_L   0x6
#define MPU6050_EXT_SYNC_ACCEL_ZOUT_L   0x7

#define MPU6050_DLPF_BW_256         0x00
#define MPU6050_DLPF_BW_188         0x01
#define MPU6050_DLPF_BW_98          0x02
#define MPU6050_DLPF_BW_42          0x03
#define MPU6050_DLPF_BW_20          0x04
#define MPU6050_DLPF_BW_10          0x05
#define MPU6050_DLPF_BW_5           0x06

#define MPU6050_GCONFIG_FS_SEL_BIT      4
#define MPU6050_GCONFIG_FS_SEL_LENGTH   2

#define MPU6050_GYRO_FS_250         0x00
#define MPU6050_GYRO_FS_500         0x01
#define MPU6050_GYRO_FS_1000        0x02
#define MPU6050_GYRO_FS_2000        0x03

#define MPU6050_ACONFIG_XA_ST_BIT           7
#define MPU6050_ACONFIG_YA_ST_BIT           6
#define MPU6050_ACONFIG_ZA_ST_BIT           5
#define MPU6050_ACONFIG_AFS_SEL_BIT         4
#define MPU6050_ACONFIG_AFS_SEL_LENGTH      2
#define MPU6050_ACONFIG_ACCEL_HPF_BIT       2
#define MPU6050_ACONFIG_ACCEL_HPF_LENGTH    3

#define MPU6050_ACCEL_FS_2          0x00
#define MPU6050_ACCEL_FS_4          0x01
#define MPU6050_ACCEL_FS_8          0x02
#define MPU6050_ACCEL_FS_16         0x03

#define MPU6050_DHPF_RESET          0x00
#define MPU6050_DHPF_5              0x01
#define MPU6050_DHPF_2P5            0x02
#define MPU6050_DHPF_1P25           0x03
#define MPU6050_DHPF_0P63           0x04
#define MPU6050_DHPF_HOLD           0x07

#define MPU6050_TEMP_FIFO_EN_BIT    7
#define MPU6050_XG_FIFO_EN_BIT      6
#define MPU6050_YG_FIFO_EN_BIT      5
#define MPU6050_ZG_FIFO_EN_BIT      4
#define MPU6050_ACCEL_FIFO_EN_BIT   3
#define MPU6050_SLV2_FIFO_EN_BIT    2
#define MPU6050_SLV1_FIFO_EN_BIT    1
#define MPU6050_SLV0_FIFO_EN_BIT    0

#define MPU6050_MULT_MST_EN_BIT     7
#define MPU6050_WAIT_FOR_ES_BIT     6
#define MPU6050_SLV_3_FIFO_EN_BIT   5
#define MPU6050_I2C_MST_P_NSR_BIT   4
#define MPU6050_I2C_MST_CLK_BIT     3
#define MPU6050_I2C_MST_CLK_LENGTH  4

#define MPU6050_CLOCK_DIV_348       0x0
#define MPU6050_CLOCK_DIV_333       0x1
#define MPU6050_CLOCK_DIV_320       0x2
#define MPU6050_CLOCK_DIV_308       0x3
#define MPU6050_CLOCK_DIV_296       0x4
#define MPU6050_CLOCK_DIV_286       0x5
#define MPU6050_CLOCK_DIV_276       0x6
#define MPU6050_CLOCK_DIV_267       0x7
#define MPU6050_CLOCK_DIV_258       0x8
#define MPU6050_CLOCK_DIV_500       0x9
#define MPU6050_CLOCK_DIV_471       0xA
#define MPU6050_CLOCK_DIV_444       0xB
#define MPU6050_CLOCK_DIV_421       0xC
#define MPU6050_CLOCK_DIV_400       0xD
#define MPU6050_CLOCK_DIV_381       0xE
#define MPU6050_CLOCK_DIV_364       0xF

#define MPU6050_I2C_SLV_RW_BIT      7
#define MPU6050_I2C_SLV_ADDR_BIT    6
#define MPU6050_I2C_SLV_ADDR_LENGTH 7
#define MPU6050_I2C_SLV_EN_BIT      7
#define MPU6050_I2C_SLV_BYTE_SW_BIT 6
#define MPU6050_I2C_SLV_REG_DIS_BIT 5
#define MPU6050_I2C_SLV_GRP_BIT     4
#define MPU6050_I2C_SLV_LEN_BIT     3
#define MPU6050_I2C_SLV_LEN_LENGTH  4

#define MPU6050_I2C_SLV4_RW_BIT         7
#define MPU6050_I2C_SLV4_ADDR_BIT       6
#define MPU6050_I2C_SLV4_ADDR_LENGTH    7
#define MPU6050_I2C_SLV4_EN_BIT         7
#define MPU6050_I2C_SLV4_INT_EN_BIT     6
#define MPU6050_I2C_SLV4_REG_DIS_BIT    5
#define MPU6050_I2C_SLV4_MST_DLY_BIT    4
#define MPU6050_I2C_SLV4_MST_DLY_LENGTH 5

#define MPU6050_MST_PASS_THROUGH_BIT    7
#define MPU6050_MST_I2C_SLV4_DONE_BIT   6
#define MPU6050_MST_I2C_LOST_ARB_BIT    5
#define MPU6050_MST_I2C_SLV4_NACK_BIT   4
#define MPU6050_MST_I2C_SLV3_NACK_BIT   3
#define MPU6050_MST_I2C_SLV2_NACK_BIT   2
#define MPU6050_MST_I2C_SLV1_NACK_BIT   1
#define MPU6050_MST_I2C_SLV0_NACK_BIT   0

#define MPU6050_INTCFG_INT_LEVEL_BIT        7
#define MPU6050_INTCFG_INT_OPEN_BIT         6
#define MPU6050_INTCFG_LATCH_INT_EN_BIT     5
#define MPU6050_INTCFG_INT_RD_CLEAR_BIT     4
#define MPU6050_INTCFG_FSYNC_INT_LEVEL_BIT  3
#define MPU6050_INTCFG_FSYNC_INT_EN_BIT     2
#define MPU6050_INTCFG_I2C_BYPASS_EN_BIT    1
#define MPU6050_INTCFG_CLKOUT_EN_BIT        0

#define MPU6050_INTMODE_ACTIVEHIGH  0x00
#define MPU6050_INTMODE_ACTIVELOW   0x01

#define MPU6050_INTDRV_PUSHPULL     0x00
#define MPU6050_INTDRV_OPENDRAIN    0x01

#define MPU6050_INTLATCH_50USPULSE  0x00
#define MPU6050_INTLATCH_WAITCLEAR  0x01

#define MPU6050_INTCLEAR_STATUSREAD 0x00
#define MPU6050_INTCLEAR_ANYREAD    0x01

#define MPU6050_INTERRUPT_FF_BIT            7
#define MPU6050_INTERRUPT_MOT_BIT           6
#define MPU6050_INTERRUPT_ZMOT_BIT          5
#define MPU6050_INTERRUPT_FIFO_OFLOW_BIT    4
#define MPU6050_INTERRUPT_I2C_MST_INT_BIT   3
#define MPU6050_INTERRUPT_PLL_RDY_INT_BIT   2
#define MPU6050_INTERRUPT_DMP_INT_BIT       1
#define MPU6050_INTERRUPT_DATA_RDY_BIT      0

// TODO: figure out what these actually do
// UMPL source code is not very obivous
#define MPU6050_DMPINT_5_BIT            5
#define MPU6050_DMPINT_4_BIT            4
#define MPU6050_DMPINT_3_BIT            3
#define MPU6050_DMPINT_2_BIT            2
#define MPU6050_DMPINT_1_BIT            1
#define MPU6050_DMPINT_0_BIT            0

#define MPU6050_MOTION_MOT_XNEG_BIT     7
#define MPU6050_MOTION_MOT_XPOS_BIT     6
#define MPU6050_MOTION_MOT_YNEG_BIT     5
#define MPU6050_MOTION_MOT_YPOS_BIT     4
#define MPU6050_MOTION_MOT_ZNEG_BIT     3
#define MPU6050_MOTION_MOT_ZPOS_BIT     2
#define MPU6050_MOTION_MOT_ZRMOT_BIT    0

#define MPU6050_DELAYCTRL_DELAY_ES_SHADOW_BIT   7
#define MPU6050_DELAYCTRL_I2C_SLV4_DLY_EN_BIT   4
#define MPU6050_DELAYCTRL_I2C_SLV3_DLY_EN_BIT   3
#define MPU6050_DELAYCTRL_I2C_SLV2_DLY_EN_BIT   2
#define MPU6050_DELAYCTRL_I2C_SLV1_DLY_EN_BIT   1
#define MPU6050_DELAYCTRL_I2C_SLV0_DLY_EN_BIT   0

#define MPU6050_PATHRESET_GYRO_RESET_BIT    2
#define MPU6050_PATHRESET_ACCEL_RESET_BIT   1
#define MPU6050_PATHRESET_TEMP_RESET_BIT    0

#define MPU6050_DETECT_ACCEL_ON_DELAY_BIT       5
#define MPU6050_DETECT_ACCEL_ON_DELAY_LENGTH    2
#define MPU6050_DETECT_FF_COUNT_BIT             3
#define MPU6050_DETECT_FF_COUNT_LENGTH          2
#define MPU6050_DETECT_MOT_COUNT_BIT            1
#define MPU6050_DETECT_MOT_COUNT_LENGTH         2

#define MPU6050_DETECT_DECREMENT_RESET  0x0
#define MPU6050_DETECT_DECREMENT_1      0x1
#define MPU6050_DETECT_DECREMENT_2      0x2
#define MPU6050_DETECT_DECREMENT_4      0x3

#define MPU6050_USERCTRL_DMP_EN_BIT             7
#define MPU6050_USERCTRL_FIFO_EN_BIT            6
#define MPU6050_USERCTRL_I2C_MST_EN_BIT         5
#define MPU6050_USERCTRL_I2C_IF_DIS_BIT         4
#define MPU6050_USERCTRL_DMP_RESET_BIT          3
#define MPU6050_USERCTRL_FIFO_RESET_BIT         2
#define MPU6050_USERCTRL_I2C_MST_RESET_BIT      1
#define MPU6050_USERCTRL_SIG_COND_RESET_BIT     0

#define MPU6050_PWR1_DEVICE_RESET_BIT   7
#define MPU6050_PWR1_SLEEP_BIT          6
#define MPU6050_PWR1_CYCLE_BIT          5
#define MPU6050_PWR1_TEMP_DIS_BIT       3
#define MPU6050_PWR1_CLKSEL_BIT         2
#define MPU6050_PWR1_CLKSEL_LENGTH      3

#define MPU6050_CLOCK_INTERNAL          0x00
#define MPU6050_CLOCK_PLL_XGYRO         0x01
#define MPU6050_CLOCK_PLL_YGYRO         0x02
#define MPU6050_CLOCK_PLL_ZGYRO         0x03
#define MPU6050_CLOCK_PLL_EXT32K        0x04
#define MPU6050_CLOCK_PLL_EXT19M        0x05
#define MPU6050_CLOCK_KEEP_RESET        0x07

#define MPU6050_PWR2_LP_WAKE_CTRL_BIT       7
#define MPU6050_PWR2_LP_WAKE_CTRL_LENGTH    2
#define MPU6050_PWR2_STBY_XA_BIT            5
#define MPU6050_PWR2_STBY_YA_BIT            4
#define MPU6050_PWR2_STBY_ZA_BIT            3
#define MPU6050_PWR2_STBY_XG_BIT            2
#define MPU6050_PWR2_STBY_YG_BIT            1
#define MPU6050_PWR2_STBY_ZG_BIT            0

#define MPU6050_WAKE_FREQ_1P25      0x0
#define MPU6050_WAKE_FREQ_2P5       0x1
#define MPU6050_WAKE_FREQ_5         0x2
#define MPU6050_WAKE_FREQ_10        0x3

#define MPU6050_BANKSEL_PRFTCH_EN_BIT       6
#define MPU6050_BANKSEL_CFG_USER_BANK_BIT   5
#define MPU6050_BANKSEL_MEM_SEL_BIT         4
#define MPU6050_BANKSEL_MEM_SEL_LENGTH      5

#define MPU6050_WHO_AM_I_BIT        6
#define MPU6050_WHO_AM_I_LENGTH     6

#define MPU6050_DMP_MEMORY_BANKS        8
#define MPU6050_DMP_MEMORY_BANK_SIZE    256
#define MPU6050_DMP_MEMORY_CHUNK_SIZE   16

#define MPU6050_FIFO_DEFAULT_TIMEOUT 11000

    struct mpu6050_config {
        uint8_t sample_rate_config;
        uint8_t config_reg;
        uint8_t gyro_config;
        uint8_t accel_config;
        uint8_t fifo_config;
        uint8_t interrupt_pin_config;
        uint8_t interrupt_config;
        uint8_t user_control;
        uint8_t pwr_mgmt_1;
        uint8_t pwr_mgmt_2;
    };

/**
 * @brief MPU6050 driver
 */
class Mpu6050 {

    using I2C_1DeviceName = DeviceString<'I', '2', 'C', '_', '1'>; 
    constexpr static uint8_t mpu6050_id = 0x68; // Part ID
    uint8_t tx_buf[250] = {};

public:
    /**
     * @brief Construct a new Mpu6050 object
     */
    Mpu6050(UsbCommHandler &controller);

    /**
     * @brief Initialization function. Used to perform actual initialization. Because of software stack initialization
     * could not be done in constructor
     * @return Status, 0 for no errors
     */
    int Initialize();    

    /**
     * @brief Configure Mpu6050 device
     * 
     * @param config Configuration details
     * @return Status, 0 for no errors
     */
    int Configure(mpu6050_config config);

    /**
     * @brief Start taking Accel and Gyro samples
     */
    void StartSampling();    

    /**
     * @brief Stop taking Accel and Gyro samples
     */
    void StopSampling();

    /**
     * @brief Get Mpu6050 Die Temperature.
     */
    void GetDieTemperature();    

    /**
     * @brief Handle Mpu6050 Interrupt. Figure out interrupt reason and take the appropriate action
     */
    void HandleInterrupt(); 

    /**
     * @brief Check if Mpu6050 device is connected to I2C bus
     */
    bool IsOnI2cBus(); 

private:
    /**
     * @brief Reset Mpu6050 device
     */
    void Reset();

    /**
     * @brief Shutdown Mpu6050 device
     */
    void Shutdown();

    /**
     * @brief Wakeup Mpu6050 device
     */
    void Wakeup();

    /**
     * @brief Called when trigger mode is received via BLE
     * 
     * @param buffer receviced buffer
     * @param length buffer length
     * @param offset data offset
     * 
     * @return true if command was processed succesfully
     */
    bool OnBleCommand(const uint8_t* buffer, Bluetooth::CommandKey key, Bluetooth::BleLength length, Bluetooth::BleOffset offset);

    /**
     * @brief Read Temperature Registers
     */
    void TemperatureRead();
    uint8_t sample_cnt;
    uint8_t packet_cnt;
    std::atomic<bool> mpu6050_is_on_i2c_bus_; ///< Device status
    I2CTransport<I2C_1DeviceName, MPU6050_DEFAULT_ADDRESS> transport; ///< I2C transport for device
    UsbCommHandler &serialHandler; ///< USB communication controller

};
```

## include/sensor_id.hpp
```c
#pragma once

#include <stddef.h>

/**
 * @brief Ids for commands sent via ble Gatt control characteristic
 */
enum class SensorId : uint8_t
{
    Ads131m08_0     = 2,
    Ads131m08_1     = 3,
    Mpu6050         = 4,
    Max30102        = 5,
    Bme280          = 6,
    Qmc5883l        = 7
};
```

## include/serial_controller.hpp
```c
#pragma once

#include <zephyr/kernel.h>

#include <atomic>

#include <zephyr/device.h>
#include <zephyr/drivers/uart.h>
#include <zephyr/sys/atomic.h>
#include "istatus_reporter.hpp"

/**
 * @brief Transfer Status
 */
enum class TransferStatus
{
    Ok,      ///< Transfer complete
    Ack,     ///< Ack status was received
    Neg,     ///< Neg status was received
    Error,   ///< Transfer error
    Timeout, ///< Serial port timeout
};

/**
 * @brief Wraps serial port request/responce data
 */
struct SerialPacket
{
    uint8_t *dataPtr;  ///< Pointer to data buffer. set to nullptr for response if data from response is not required.
    uint8_t messageId; ///< Message Id
    uint8_t length;    ///< Data length
};

/**
 * @brief Encapsulates serial port transfer
 */
struct SerialTransfer
{
    SerialPacket *request;       ///< Data packet to be send via serial port
    SerialPacket *response;      ///< Data packet where serial port response will be written
    uint32_t key;                ///< Data key. Could be used to stored additional data
    k_work callback;             ///< Data transfer complete callback. set to nullptr if no callback is required
    void *context;               ///< Transfer context.
    std::atomic<bool> completed; ///< Set to true if when command is completed.
};

/**
 * @brief Serial port communication controller. Encapsulates asyncronus USB/UART communication with the PC.
 */
class SerialController : public IStatusReporter
{
    constexpr static size_t BufferSize = 256; ///< Send and Receive buffer size
    constexpr static int MaxEntryCount = 20;  ///< Maximum number of scheduled serial commands.
    k_timeout_t transferTimeout = K_MSEC(50); ///< Transfer timeout

public:
    /**
     * @brief Construct Serial Controller.
     * @note Only one instance could be constructed
     */
    SerialController();

    /**
     * @brief Initialization function. Used to perform actual initialization. Because of software stack initialization
     * could not be done in constructor
     */
    void Initialize();

    /**
     * @brief Queues transfer via serial port
     * 
     * @param task queued task
     * @return true if task was successfully added to queue, false owtherwise
     */
    bool QueueTransfer(SerialTransfer *task);

    /**
     * @brief Check if SerialController is initialized
     *      
     * @return true if initialized, false owtherwise
     */
    bool IsInitialized();

    /**
     * @brief Get status of last operation
     * 
     * @return Status, 0 for no errors
     */
    virtual uint8_t GetStatus() override;

private:
    /**
     * @brief Serial port event callback. called every time, state of the uart port. Used to track buffers 
     * and enables data receive after command is sent via serial port.
     * 
     * @param dev  serial port device 
     * @param evt  serial port event
     * @param data pointer to instance of current instance of the serial port controller.
     */
    static void SerialPortCallback(const device *dev, uart_event *evt, void *data);

    static void interrupt_handler(const struct device *dev, void *user_data);

    /**
     * @brief Thread used to manage serial controller task working queue and controls high level transfers.
     * 
     * @param data pointer to current instance of Serial controller
     */
    static void WorkingThread(void *data, void *, void *);

    /**
     * @brief Prepare message buffer and send it via UART
     * 
     * @param packet serial packed to send
     * @return TransferStatus transfer result
     */
    TransferStatus SendPacket(const SerialPacket &packet);

    /**
     * @brief Send Neg message.
     * 
     * @return TransferStatus transfer status
     */
    TransferStatus SendNeg();

    /**
     * @brief Sends prepared send buffer.
     * 
     * @param packetSize number of bytes to send
     * 
     * @return TransferStatus transfer status. Return TransferStatus::Timeout if timeout event occurs.
     */
    TransferStatus SendInternal(size_t packetSize);

    /**
     * @brief Handles receive from connected UART
     * 
     * @param packet reference where received data should be stored
     * @return TransferStatus Transfer status.
     */
    TransferStatus Receive(SerialPacket &packet);

    /**
     * @brief Serialize packet into internal send buffer
     * 
     * @param packet packet to serialize
     * @return number of bytes in serial packet.
     */
    size_t SerializeCommand(const SerialPacket &packet);

    /**
     * @brief Parse receive buffer and if receive buffer contains valid data writes them into output packet
     * 
     * @param packet reference to Serial port packet where response should be written.
     * @return TransferStatus transfer status
     */
    TransferStatus ParseBuffer(SerialPacket &packet);

    const device *uartDevice;       ///< UART device
    const device *dev;       ///< UART devicedev
    uint8_t recvBuffer[BufferSize]; ///< recevice buffer;
    size_t recvLength;              ///< number of bytes was recived via current transfer
    uint8_t sendBuffer[BufferSize]; ///< send buffer;

    k_sem rxSem; ///< Data received semaphore
    k_sem txSem; ///< Data sent semaphore.

    k_msgq messageQueue;                   ///< Serial port task queue
    SerialTransfer *buffer[MaxEntryCount]; ///< Serial port task buffer
    std::atomic<bool> serial_is_initialized_; ///< Device status
};
```

## src/audio_module.cpp
```c
#include <zephyr/logging/log.h>
#include <zephyr/sys/printk.h>

#include "audio_module.hpp"
#include "ble_service.hpp"
#include "usb_comm_handler.hpp"
// For registering callback
#include "ble_service.hpp"

#define DEVICE_NODE DT_BUS(DT_NODELABEL(i2s_rxtx))

/** Register log module */
LOG_MODULE_REGISTER(i2s, LOG_LEVEL_INF);

/* Define a new Memory Slab which consistes of NUM_BLOCKS blocks
   __________________________________________________________________________
  |    Block 0   |    Block 1   |    Block 2   |    Block 3   |    Block 4   |
  |    0...31    |    0...31    |    0...31    |    0...31    |    0...31    |
  |______________|______________|______________|______________|______________|
*/
static K_MEM_SLAB_DEFINE(mem_slab, I2S_BLOCK_SIZE, NUM_BLOCKS, NUM_SAMPLES);

AudioModule::AudioModule() {
    LOG_DBG("AudioModule Constructor!");
}

int AudioModule::Initialize() {

    LOG_DBG("Starting AudioModule Initialization...");

    i2s_dev = DEVICE_DT_GET(DEVICE_NODE);
    if (!device_is_ready(i2s_dev)) {
        LOG_ERR("%s is not ready\n", i2s_dev->name);
        return -1;
    } else {
        LOG_DBG("i2s_dev ready!");
    }

    struct i2s_config i2s_cfg;
    i2s_cfg.word_size = 16; // due to int16_t in data_frame declaration
    i2s_cfg.channels = 2; // L + R channel
    i2s_cfg.format = I2S_FMT_DATA_FORMAT_I2S;
    i2s_cfg.options = I2S_OPT_BIT_CLK_MASTER | I2S_OPT_FRAME_CLK_MASTER;
    i2s_cfg.frame_clk_freq = 44100;
    i2s_cfg.mem_slab = &mem_slab;
    i2s_cfg.block_size = I2S_BLOCK_SIZE;
    i2s_cfg.timeout = 1000;
    
    int ret = i2s_configure(i2s_dev, I2S_DIR_TX, &i2s_cfg);
    if (ret < 0) {
        LOG_ERR("Failed to configure the I2S stream: (%d)\n", ret);
        return ret;
    } else {
        LOG_DBG("i2s_configured successfully!");
    }

    ret = k_mem_slab_alloc(&mem_slab, &mem_blocks, K_NO_WAIT);
    if (ret < 0) {
        LOG_ERR("Failed to allocate the memory blocks: %d\n", ret);
        return ret;
    } else {
        LOG_DBG("slab allocated successfully!");
    }

    memset((uint16_t*)mem_blocks, 0, (NUM_SAMPLES * NUM_BLOCKS));

    Bluetooth::GattRegisterControlCallback(CommandId::AlarmCmd,
        [this](const uint8_t *buffer, Bluetooth::CommandKey key, Bluetooth::BleLength length, Bluetooth::BleOffset offset)
        {
            return OnBleCommand(buffer, key, length, offset);
        });

    // Start working thread
    k_thread_create(&worker, pollStackAreaAudio, K_THREAD_STACK_SIZEOF(pollStackAreaAudio),
                    &WorkingThreadAudio, this, nullptr, nullptr, taskPriorityAudio, 0, K_NO_WAIT);
    k_thread_suspend(&worker);

    return ret;    
}

bool AudioModule::OnBleCommand(const uint8_t *buffer, Bluetooth::CommandKey key, Bluetooth::BleLength length, Bluetooth::BleOffset offset){
    if (offset.value != 0 || length.value == 0)
    {
        return false;
    }
    LOG_DBG("AudioModule BLE Command received");

    Bluetooth::CommandKey bleCommand;
    memcpy(&bleCommand, &key, sizeof(key));

    switch(bleCommand.key[0]){
        case static_cast<uint8_t>(BleCommand::StartSampling):
            StartSampling();
            break;
        case static_cast<uint8_t>(BleCommand::StopSampling):
            StopSampling();
            break;

        default:
            break;
    }

    return true;
}

int AudioModule::StartSampling(){
    /* Start the transmission of data */
	int ret = i2s_trigger(i2s_dev, I2S_DIR_TX, I2S_TRIGGER_START);
	if (ret < 0) {
		LOG_ERR("Failed to start the transmission: %d", ret);
	} else {
        LOG_DBG("Resuming thread...");
        k_thread_resume(&worker);
    }
    return ret;
}

int AudioModule::StopSampling(){
	/* Start the transmission of data */
	int ret = i2s_trigger(i2s_dev, I2S_DIR_TX, I2S_TRIGGER_DRAIN);
	if (ret < 0) {
		LOG_ERR("Failed to stop the transmission: %d", ret);
	} else {
        LOG_DBG("Suspending thread...");
        k_thread_suspend(&worker);
    }
    return ret;
}

    /**
     * @brief Main working thread. Used to perform I2S transport.
     * It required a separate stack to not break main BLE stack state machine
     *
     * @param data pointer to this
     */
    void AudioModule::WorkingThreadAudio(void *data, void *, void *){
        AudioModule *self = static_cast<AudioModule *>(data);
        int ret = 0;
        uint32_t idx;
        uint32_t j = 0;

        for (;;)
        {
            /* Put data into the tx buffer */
            for (int i = 0; i < NUM_SAMPLES * NUM_BLOCKS; i++) {
                idx = 2 * (NUM_BLOCKS * NUM_SAMPLES) * j + 2*i;
                ((uint16_t*)self->mem_blocks)[i] = ((self->rawAudioData[idx+1]) << 8) | self->rawAudioData[idx];
                if (j >= self->J_LIMIT){
                    ((uint16_t*)self->mem_blocks)[i] = 0;
                }
            }

            j++;
            if (j >= 2*self->J_LIMIT){
                j = 0;
            }
            /* Write Data */
            ret = i2s_buf_write(self->i2s_dev, self->mem_blocks, I2S_BLOCK_SIZE);
            if (ret < 0) {
                LOG_ERR("Error: i2s_write failed with %d", ret);
            }
        }

    }
```

## src/bme280.cpp
```c
#include "bme280.hpp"
// For registering callback
#include "ble_service.hpp"

LOG_MODULE_REGISTER(bme280, LOG_LEVEL_INF);

Bme280::Bme280(UsbCommHandler &controller) : serialHandler(controller) {
    LOG_DBG("Bme280 Constructor!");
    k_timer_init(&timer, &Bme280::TimerHandler, nullptr);
    k_sem_init(&pollSemaphore, 0, 1);    
}

int Bme280::Initialize() {

    int ret = 0;
    // uint8_t part_id;
    
    LOG_DBG("Starting Bme280 Initialization..."); 
    
    packet_cnt = 0;
    sample_cnt = 0;
    bme280_dev = get_bme280_device();

    if (bme280_dev != nullptr){
        GetChipId(bme280_dev);
        // Start working thread
        k_thread_create(&worker, pollStackArea, K_THREAD_STACK_SIZEOF(pollStackArea),
                        &WorkingThread, this, nullptr, nullptr, taskPriority, 0, K_NO_WAIT);        
    } else {
        bme280_is_on_i2c_bus_.store(false, std::memory_order_relaxed);
        bmp280_is_on_i2c_bus_.store(false, std::memory_order_relaxed);
        bmx_id = 0x00;
        return -1;        
    }

    Bluetooth::GattRegisterControlCallback(CommandId::Bme280Cmd,
        [this](const uint8_t *buffer, Bluetooth::CommandKey key, Bluetooth::BleLength length, Bluetooth::BleOffset offset)
        {
            return OnBleCommand(buffer, key, length, offset);
        });

    return ret;
}

bool Bme280::OnBleCommand(const uint8_t *buffer, Bluetooth::CommandKey key, Bluetooth::BleLength length, Bluetooth::BleOffset offset){
    if (offset.value != 0 || length.value == 0)
    {
        return false;
    }
    LOG_DBG("Bme280 BLE Command received");

    Bluetooth::CommandKey bleCommand;
    memcpy(&bleCommand, &key, sizeof(key));
          
    switch(bleCommand.key[0]){
        case static_cast<uint8_t>(BleCommand::StartSampling):
            StartSampling();
            break;
        case static_cast<uint8_t>(BleCommand::StopSampling):
            StopSampling();
            break;
        
        default:
            break;
    }
    
    return true;
}

void Bme280::GetChipId(const struct device *dev){
    struct bme280_data *data = ToData(dev);

    bmx_id = data->chip_id;
    if(data->chip_id == bme280_id){
        LOG_DBG("BME280 on I2C bus!");
        bme280_is_on_i2c_bus_.store(true, std::memory_order_relaxed);
    } else if (data->chip_id == bmp280_id_sample_1 || data->chip_id == bmp280_id_mp){
        LOG_DBG("BMP280 on I2C bus!");
        bmp280_is_on_i2c_bus_.store(true, std::memory_order_relaxed);
    }
}
const struct device * Bme280::get_bme280_device(void){
	
    // const struct device *dev = DEVICE_DT_GET(DT_BUS(DT_NODELABEL(bme280)));
    const struct device *dev = DEVICE_DT_GET_ANY(bosch_bme280);

	if (dev == nullptr) {
		/* No such node, or the node does not have status "okay". */
		LOG_ERR("\nError: no BME280 device found.\n");
		return nullptr;
	}

	if (!device_is_ready(dev)) {
		LOG_ERR("\nError: Device \"%s\" is not ready; "
		       "check the driver initialization logs for errors.\n",
		       dev->name);        
		return nullptr;
	}

	LOG_DBG("Found device \"%s\", getting sensor data\n", dev->name);
	return dev;    
}

struct bme280_data * Bme280::ToData(const struct device *dev){
    return static_cast<bme280_data *>(dev->data);
}

void Bme280::StartSampling(){
    // Start BME280 polling
    k_timer_start(&timer, K_MSEC(pollPeriod), K_MSEC(pollPeriod));
}   

void Bme280::StopSampling(){
    k_timer_stop(&timer);
}

bool Bme280::BmX280IsOnI2cBus(){
    bool status;
    // Return TRUE if either of BMP280 or BME280 is on I2C bus
    status = (bme280_is_on_i2c_bus_.load(std::memory_order_relaxed) || bmp280_is_on_i2c_bus_.load(std::memory_order_relaxed));
    return status;
}

bool Bme280::Bme280IsOnI2cBus(){
    bool status;
    // Return TRUE if BME280 is on I2C bus
    status = bme280_is_on_i2c_bus_.load(std::memory_order_relaxed);
    return status;
}
```

## src/qmc5883l.cpp
```c
#include <zephyr/kernel.h>
#include <string.h>
#include <zephyr/init.h>
#include <zephyr/drivers/gpio.h>
#include <zephyr/sys/printk.h>
//#include <sys/__assert.h>
#include <stdlib.h>
#include <zephyr/logging/log.h>

#include "qmc5883l.hpp"
#include "ble_service.hpp"
#include "usb_comm_handler.hpp"
// For registering callback
#include "ble_service.hpp"

#define DEVICE_NODE DT_NODELABEL(i2c1)

LOG_MODULE_REGISTER(qmc5883l, LOG_LEVEL_INF);

Qmc5883l::Qmc5883l(UsbCommHandler &controller) : serialHandler(controller) {
    LOG_DBG("Qmc5883l Constructor!");
}

int Qmc5883l::Initialize() {

    int ret = 0;
    uint8_t part_id;
    
    LOG_DBG("Starting Qmc5883l Initialization..."); 
    sample_cnt = 0;
    packet_cnt = 0;
    const struct device* dev = DEVICE_DT_GET(DEVICE_NODE);
    transport.Initialize(dev);   
    
    qmc5883l_is_on_i2c_bus_.store(false, std::memory_order_relaxed);

    part_id = transport.ReadRegister(QMC5883L_WHO_AM_I);

    if(part_id == qmc5883l_id){
        LOG_DBG("SUCCESS: QMC5883L ID match!");
        qmc5883l_is_on_i2c_bus_.store(true, std::memory_order_relaxed);
    } else {
        LOG_ERR("Wrong ID: 0x%X", part_id);
        return -1;
    }
    /* wake up chip */
    //Wakeup();
    Reset();
    k_msleep(5);
//    Shutdown();

    Bluetooth::GattRegisterControlCallback(CommandId::Qmc5883lCmd,
        [this](const uint8_t *buffer, Bluetooth::CommandKey key, Bluetooth::BleLength length, Bluetooth::BleOffset offset)
        {
            return OnBleCommand(buffer, key, length, offset);
        });

    return 0;
}

int Qmc5883l::Configure(qmc5883l_config config){
    uint8_t status;   

    transport.WriteRegister(QMC5883L_SET_RESET_PERIOD, 0x01); // Recommended by QMC5883L datasheet
    transport.WriteRegister(QMC5883L_CTRL_REG_1, config.ctrl_reg_1);
    transport.WriteRegister(QMC5883L_CTRL_REG_2, config.ctrl_reg_2);

    // Read one of the XYZ output registers to clear DRDY
    status = transport.ReadRegister(QMC5883L_Z_MSB);

    status = transport.GetStatus();
    return status;
}

bool Qmc5883l::OnBleCommand(const uint8_t *buffer, Bluetooth::CommandKey key, Bluetooth::BleLength length, Bluetooth::BleOffset offset){
    if (offset.value != 0 || length.value == 0)
    {
        return false;
    }
    LOG_DBG("Qmc5883l BLE Command received");

    Bluetooth::CommandKey bleCommand;
    memcpy(&bleCommand, &key, sizeof(key));
          
    switch(bleCommand.key[0]){
        case static_cast<uint8_t>(BleCommand::StartSampling):
            StartSampling();
            break;
        case static_cast<uint8_t>(BleCommand::StopSampling):
            StopSampling();
            break;
        
        default:
            break;
    }
    
    return true;
}

void Qmc5883l::Reset() {
    uint8_t user_ctrl_reg;
    // Write 1 to SOFT_RST bit. This will restore default value of all registers.
    // QMC5883L immediately switches to standby mode.
    transport.UpdateRegister(QMC5883L_CTRL_REG_2, BIT(QMC5883L_SOFT_RST_BIT), 0xFF);    

    LOG_DBG("Qmc5883l Reset Success!");
}

void Qmc5883l::Shutdown() {
    // Write 00 to Mode[1:0] bits
    transport.UpdateRegister(QMC5883L_CTRL_REG_1, QMC5833L_MODE_MASK, 0x00);
}

void Qmc5883l::Wakeup() {
    // Write 01 to Mode[1:0] bits
    transport.UpdateRegister(QMC5883L_CTRL_REG_1, QMC5833L_MODE_MASK, 0x01);
}

void Qmc5883l::StartSampling(){    
    Wakeup();
}   

void Qmc5883l::StopSampling(){
    Shutdown();
}

void Qmc5883l::GetDieTemperature(){

}   

void Qmc5883l::HandleInterrupt(){
    //LOG_INF("Handling Qmc5883l interrupt!");
    uint8_t int_reason;
    int_reason = transport.ReadRegister(QMC5883L_STATUS_REG);
    
    if(int_reason & BIT(QMC5883L_OVL_BIT)){
        LOG_DBG("Sensor value overflow!");
        // Read one of the XYZ output registers to clear DRDY
        transport.ReadRegister(QMC5883L_Z_MSB);
    }

    if(int_reason & BIT(QMC5883L_DOR_BIT)){
        LOG_DBG("QMC5883L Data Skip (DOR) Interrupt!");
        // Read one of the XYZ output registers to clear DRDY
        transport.ReadRegister(QMC5883L_Z_MSB);        
    }

    if(int_reason & BIT(QMC5883L_DRDY_BIT)){
        //LOG_INF("QMC5883L Data Ready interrupt!");
        // Store Accel and Gyro samples
        transport.ReadRegisters(QMC5883L_X_LSB, (tx_buf + 6*sample_cnt + 1), 6);        
        sample_cnt++;
        if(sample_cnt == 40){
            //Store Temperature reading
            transport.ReadRegisters(QMC5883L_TOUT_LSB, (tx_buf + 6*sample_cnt + 1), 2);
            tx_buf[0] = packet_cnt;            
            packet_cnt++;
            sample_cnt = 0;          
            Bluetooth::Qmc5883lNotify(tx_buf, 243);
            serialHandler.SendMagnetometerSamples(tx_buf, 243);
        }
    }
} 

bool Qmc5883l::IsOnI2cBus(){
    bool status;
    status = qmc5883l_is_on_i2c_bus_.load(std::memory_order_relaxed);
    return status;
}
```
